#define HOST_OS 1 // Set 1 for Linux, defaults to 0 (Windows)

#include "./zmk-helpers/helper.h"
#include "./zmk-helpers/keypos_def/keypos_glv80.h"

#include <behaviors.dtsi>
/* Include behaviour includes needed by key binds - automatically generated */
#include <dt-bindings/zmk/keys.h>
#include <dt-bindings/zmk/bt.h>
#include <dt-bindings/zmk/rgb.h>
#include <dt-bindings/zmk/outputs.h>

#define QUICK_TAP_MS 175
#define THUMB_QUICK_TAP_MS 250
#define TAPPING_TERM_MS 250
#define COMBO_TIMING 25

#define LAYER_BASE 0
#define LAYER_MAGIC 1
#define LAYER_LOWER 2
#define LAYER_LANG 3
#define LAYER_NUMS 4
#define LAYER_SYMB 5

#define ___ &trans
#define _x_ &none

/* Glove80 system behavior & macros */
/ {
    macros {
        rgb_ug_status_macro: rgb_ug_status_macro {
            label = "RGB_UG_STATUS";
            compatible = "zmk,behavior-macro";
            #binding-cells = <0>;
            bindings
                = <&rgb_ug RGB_STATUS>;
        };
    };
};


/ {
#ifdef BT_DISC_CMD
    behaviors {
        bt_0: bt_0 {
            compatible = "zmk,behavior-tap-dance";
            label = "BT_0";
            #binding-cells = <0>;
            tapping-term-ms = <200>;
            bindings = <&bt_select_0>, <&bt BT_DISC 0>;
        };
        bt_1: bt_1 {
            compatible = "zmk,behavior-tap-dance";
            label = "BT_1";
            #binding-cells = <0>;
            tapping-term-ms = <200>;
            bindings = <&bt_select_1>, <&bt BT_DISC 1>;
        };
        bt_2: bt_2 {
            compatible = "zmk,behavior-tap-dance";
            label = "BT_2";
            #binding-cells = <0>;
            tapping-term-ms = <200>;
            bindings = <&bt_select_2>, <&bt BT_DISC 2>;
        };
        bt_3: bt_3 {
            compatible = "zmk,behavior-tap-dance";
            label = "BT_3";
            #binding-cells = <0>;
            tapping-term-ms = <200>;
            bindings = <&bt_select_3>, <&bt BT_DISC 3>;
        };
    };
    macros {
        bt_select_0: bt_select_0 {
            label = "BT_SELECT_0";
            compatible = "zmk,behavior-macro";
            #binding-cells = <0>;
            bindings
                = <&out OUT_BLE>,
                  <&bt BT_SEL 0>;
        };
        bt_select_1: bt_select_1 {
            label = "BT_SELECT_1";
            compatible = "zmk,behavior-macro";
            #binding-cells = <0>;
            bindings
                = <&out OUT_BLE>,
                  <&bt BT_SEL 1>;
        };
        bt_select_2: bt_select_2 {
            label = "BT_SELECT_2";
            compatible = "zmk,behavior-macro";
            #binding-cells = <0>;
            bindings
                = <&out OUT_BLE>,
                  <&bt BT_SEL 2>;
        };
        bt_select_3: bt_select_3 {
            label = "BT_SELECT_3";
            compatible = "zmk,behavior-macro";
            #binding-cells = <0>;
            bindings
                = <&out OUT_BLE>,
                  <&bt BT_SEL 3>;
        };
    };
#else
    macros {
        bt_0: bt_0 {
            label = "BT_0";
            compatible = "zmk,behavior-macro";
            #binding-cells = <0>;
            bindings
                = <&out OUT_BLE>,
                  <&bt BT_SEL 0>;
        };
        bt_1: bt_1 {
            label = "BT_1";
            compatible = "zmk,behavior-macro";
            #binding-cells = <0>;
            bindings
                = <&out OUT_BLE>,
                  <&bt BT_SEL 1>;
        };
        bt_2: bt_2 {
            label = "BT_2";
            compatible = "zmk,behavior-macro";
            #binding-cells = <0>;
            bindings
                = <&out OUT_BLE>,
                  <&bt BT_SEL 2>;
        };
        bt_3: bt_3 {
            label = "BT_3";
            compatible = "zmk,behavior-macro";
            #binding-cells = <0>;
            bindings
                = <&out OUT_BLE>,
                  <&bt BT_SEL 3>;
        };
    };
#endif
};

/ {
    behaviors {
        magic: magic {
            compatible = "zmk,behavior-hold-tap";
            label = "MAGIC_HOLD_TAP";
            #binding-cells = <2>;
            flavor = "tap-preferred";
            tapping-term-ms = <200>;
            bindings = <&mo>, <&rgb_ug_status_macro>;
        };
    };
};


#define KEYS_L      \
           0  1  2  3  4  \
        10 11 12 13 14 15 \
        22 23 24 25 26 27 \
        34 35 36 37 38 39 \
        46 47 48 49 50 51 \
        64 65 66 67 68
#define KEYS_R \
        5  6  7  8  9 \
        16 17 18 19 20 21 \
        28 29 30 31 32 33 \
        40 41 42 43 44 45 \
        58 59 60 61 62 63 \
        75 76 77 78 79
#define THUMBS \
        69 52 57 74 \
        70 53 56 73 \
        71 54 55 72

#define MAKE_HRM(NAME, HOLD, TAP, TRIGGER_POS) \
    ZMK_BEHAVIOR(NAME, hold_tap, \
        flavor = "balanced"; \
        tapping-term-ms = <TAPPING_TERM_MS>; \
        quick-tap-ms = <QUICK_TAP_MS>; \
        require-prior-idle-ms = <150>; \
        bindings = <HOLD>, <TAP>; \
        hold-trigger-key-positions = <TRIGGER_POS>; \
        hold-trigger-on-release; \
    )

MAKE_HRM(hml, &kp, &kp, KEYS_R THUMBS)  // left-hand HRMs
MAKE_HRM(hmr, &kp, &kp, KEYS_L THUMBS)  // right-hand HRMs
MAKE_HRM(hml_repeat, &kp, &key_repeat, KEYS_R THUMBS)  // used for HRM-combo

ZMK_BEHAVIOR(ltr, hold_tap,
    flavor = "balanced";
    tapping-term-ms = <TAPPING_TERM_MS>;
    quick-tap-ms = <QUICK_TAP_MS>;
    require-prior-idle-ms = <150>;
    bindings = <&mo>, <&kp>;

    hold-trigger-key-positions = <KEYS_R>;
)

ZMK_BEHAVIOR(ltl, hold_tap,
    flavor = "balanced";
    tapping-term-ms = <TAPPING_TERM_MS>;
    quick-tap-ms = <QUICK_TAP_MS>;
    require-prior-idle-ms = <150>;
    bindings = <&mo>, <&kp>;

    hold-trigger-key-positions = <KEYS_L>;
)

ZMK_UNICODE_SINGLE(curr_euro, N2, N0, A, C)  // € (Euro)
//                  name       lowercase         uppercase
ZMK_UNICODE_PAIR(de_ae,     N0, N0,  E, N4,    N0, N0,  C, N4)
ZMK_UNICODE_PAIR(de_oe,     N0, N0,  F, N6,    N0, N0,  D, N6)
ZMK_UNICODE_PAIR(de_ue,     N0, N0,  F,  C,    N0, N0,  D,  C)
ZMK_UNICODE_PAIR(de_eszett, N0, N0,  D,  F,    N1,  E, N9,  E)
ZMK_UNICODE_PAIR(si_ccaron, N0, N1, N0,  D,    N0, N1, N0,  C) // Č (C with caron)
ZMK_UNICODE_PAIR(si_scaron, N0, N1, N6, N1,    N0, N1, N6, N0) // Š (S with caron)
ZMK_UNICODE_PAIR(si_zcaron, N0, N1, N7,  E,    N0, N1, N7,  D) // Ž (Z with caron)

ZMK_COMBO(backspace, &kp BSPC,  RT1 RT2, LAYER_BASE, COMBO_TIMING) // Backspace combo [L U]
ZMK_COMBO(delete,    &kp DEL,   RT2 RT3, LAYER_BASE, COMBO_TIMING) // Delete combo [U Y]
ZMK_COMBO(enter,     &kp ENTER, RB1 RB2, LAYER_BASE, COMBO_TIMING) // Enter combo [H ,]
ZMK_COMBO(escape,    &kp ESC,   LT1 LT2, LAYER_BASE, COMBO_TIMING) // Escape combo [F P]
ZMK_COMBO(space,     &kp SPACE, LB1 LB2, LAYER_BASE, COMBO_TIMING) // Space combo [C D]
ZMK_COMBO(tab,       &kp TAB,   LB3 LB2, LAYER_BASE, COMBO_TIMING) // Tab combo [C X]

/ {
    macros {
        go_assign: go_assign {
            compatible = "zmk,behavior-macro";
            label = "GO_ASSIGN";
            #binding-cells = <0>;
            bindings = <&kp COLON &kp EQUAL>;
        };
    };
};

// 0
GLV80_LAYER(base,
// ╭───────────────┬───────────────┬───────────────┬───────────────┬───────────────╮                                   ╭───────────────┬───────────────┬───────────────┬───────────────┬───────────────╮
    ___             ___             ___             ___             ___                                                 ___             ___             ___             ___             ___
// ├───────────────┼───────────────┼───────────────┼───────────────┼───────────────┼───────────────╮   ╭───────────────┼───────────────┼───────────────┼───────────────┼───────────────┼───────────────┤
    ___             ___             ___             ___             ___             ___                 ___             ___             ___             ___             ___             ___
// ├───────────────┼───────────────┼───────────────┼───────────────┼───────────────┼───────────────┤   ├───────────────┼───────────────┼───────────────┼───────────────┼───────────────┼───────────────┤
    ___             &kp Q           &kp W           &kp F           &kp P           &kp B               &kp J           &kp L           &kp U           &kp Y           &kp COLON       ___
// ├───────────────┼───────────────┼───────────────┼───────────────┼───────────────┼───────────────┤   ├───────────────┼───────────────┼───────────────┼───────────────┼───────────────┼───────────────┤
    ___             &kp A           &hml LALT R     &hml LCTRL S    &hml LSHIFT T   &hml LGUI G         &kp M           &hmr RSHIFT N   &hmr RCTRL E    &hmr RALT I     &kp O           ___
// ├───────────────┼───────────────┼───────────────┼───────────────┼───────────────┼───────────────┤   ├───────────────┼───────────────┼───────────────┼───────────────┼───────────────┼───────────────┤
    ___             &kp Z           &kp X           &kp C           &kp D           &kp V            ,  &ltr 3 K        &kp H           &kp COMMA       &kp DOT         &kp TAB         ___
// ├───────────────┼───────────────┼───────────────┼───────────────┼───────────────┼───────────────╯   ╰───────────────┼───────────────┼───────────────┼───────────────┼───────────────┼───────────────┤
    ___             ___             ___             ___             ___                              ,                  ___             ___             ___             ___             ___
// ╰───────────────┴───────────────┴───────────────┴───────────────┴───────────────╯                                   ╰───────────────┴───────────────┴───────────────┴───────────────┴───────────────╯
                                                                                                     ,
//                                         ╭───────────────┬───────────────┬───────────────╮                   ╭───────────────┬───────────────┬───────────────╮
                                            ___             ___             ___                                 ___             ___             &kp ESC
                                        /* ├───────────────┼───────────────┼───────────────┤ */      ,      /* ├───────────────┼───────────────┼───────────────┤ */
                                            &kp BSPC        &mo 4           &mo 5                               &mo 3           &kp ENTER       &kp SPACE
//                                         ╰───────────────┴───────────────┴───────────────╯                   ╰───────────────┴───────────────┴───────────────╯
)

// 1
GLV80_LAYER(magic,
// ╭───────────────┬───────────────┬───────────────┬───────────────┬───────────────╮                                   ╭───────────────┬───────────────┬───────────────┬───────────────┬───────────────╮
    &bt BT_CLR      _x_             _x_             _x_             _x_                                                 _x_             _x_             _x_             _x_             &bt BT_CLR_ALL
// ├───────────────┼───────────────┼───────────────┼───────────────┼───────────────┼───────────────╮   ╭───────────────┼───────────────┼───────────────┼───────────────┼───────────────┼───────────────┤
    _x_             _x_             _x_             _x_             _x_             _x_                 _x_             _x_             _x_             _x_             _x_             _x_
// ├───────────────┼───────────────┼───────────────┼───────────────┼───────────────┼───────────────┤   ├───────────────┼───────────────┼───────────────┼───────────────┼───────────────┼───────────────┤
    _x_             &rgb_ug RGB_SPI &rgb_ug RGB_SAI &rgb_ug RGB_HUI &rgb_ug RGB_BRI &rgb_ug RGB_TOG     _x_             _x_             _x_             _x_             _x_             _x_
// ├───────────────┼───────────────┼───────────────┼───────────────┼───────────────┼───────────────┤   ├───────────────┼───────────────┼───────────────┼───────────────┼───────────────┼───────────────┤
    &bootloader     &rgb_ug RGB_SPD &rgb_ug RGB_SAD &rgb_ug RGB_HUD &rgb_ug RGB_BRD &rgb_ug RGB_EFF     _x_             _x_             _x_             _x_             _x_             &bootloader
// ├───────────────┼───────────────┼───────────────┼───────────────┼───────────────┼───────────────┤   ├───────────────┼───────────────┼───────────────┼───────────────┼───────────────┼───────────────┤
    &sys_reset      _x_             _x_             _x_             _x_             _x_              ,  _x_             _x_             _x_             _x_             _x_             &sys_reset
// ├───────────────┼───────────────┼───────────────┼───────────────┼───────────────┼───────────────╯   ╰───────────────┼───────────────┼───────────────┼───────────────┼───────────────┼───────────────┤
    _x_             _x_             _x_             _x_             _x_                              ,                  _x_             _x_             _x_             _x_             _x_
// ╰───────────────┴───────────────┴───────────────┴───────────────┴───────────────╯                                   ╰───────────────┴───────────────┴───────────────┴───────────────┴───────────────╯
                                                                                                     ,
//                                         ╭───────────────┬───────────────┬───────────────╮                   ╭───────────────┬───────────────┬───────────────╮
                                            _x_             &bt_2           &bt_3                               _x_             _x_             _x_
                                        /* ├───────────────┼───────────────┼───────────────┤ */      ,      /* ├───────────────┼───────────────┼───────────────┤ */
                                            &bt_0           &bt_1           &out OUT_USB                        &to 0           _x_             _x_
//                                         ╰───────────────┴───────────────┴───────────────╯                   ╰───────────────┴───────────────┴───────────────╯
)

// 2
GLV80_LAYER(lower,
/* ╭───────────────┬───────────────┬───────────────┬───────────────┬───────────────╮                                   ╭───────────────┬───────────────┬───────────────┬───────────────┬───────────────╮ */
    &kp C_BRI_DN    &kp C_BRI_UP    &magic 1 0      &to 0            &to 3                                               &kp C_MUTE      &kp C_VOL_DN    &kp C_VOL_UP    ___            &kp PAUSE_BREAK
/* ├───────────────┼───────────────┼───────────────┼───────────────┼───────────────┼───────────────╮   ╭───────────────┼───────────────┼───────────────┼───────────────┼───────────────┼───────────────┤ */
    ___             _x_             _x_             _x_             _x_             &kp HOME            &kp LPAR        &kp KP_NUM      &kp BSLH        &kp FSLH        &kp KP_MULTIPLY &kp PRINTSCREEN
/* ├───────────────┼───────────────┼───────────────┼───────────────┼───────────────┼───────────────┤   ├───────────────┼───────────────┼───────────────┼───────────────┼───────────────┼───────────────┤ */
    ___             _x_             _x_             &kp UP_ARROW    _x_             &kp END             &kp RPAR        &kp N7          &kp N8           &kp N9          &kp MINUS      &kp SCROLLLOCK
/* ├───────────────┼───────────────┼───────────────┼───────────────┼───────────────┼───────────────┤   ├───────────────┼───────────────┼───────────────┼───────────────┼───────────────┼───────────────┤ */
    ___             _x_             &kp LEFT_ARROW  &kp DOWN_ARROW  &kp RIGHT_ARROW &kp PG_UP           &kp PERCENT     &kp N4          &kp N5           &kp N6          &kp PLUS       _x_
/* ├───────────────┼───────────────┼───────────────┼───────────────┼───────────────┼───────────────┤   ├───────────────┼───────────────┼───────────────┼───────────────┼───────────────┼───────────────┤ */
    ___             &kp K_APP       _x_             &kp F11         &kp F12         &kp PG_DN        ,  &kp COMMA       &kp N1          &kp N2           &kp N3          &kp LBKT       ___
/* ├───────────────┼───────────────┼───────────────┼───────────────┼───────────────┼───────────────╯   ╰───────────────┼───────────────┼───────────────┼───────────────┼───────────────┼───────────────┤ */
    ___             &kp CAPS        &kp INS         &kp F11         &kp F12                          ,                  &kp N0          &kp N0           &kp DOT         &kp RBKT       ___
/* ╰───────────────┴───────────────┴───────────────┴───────────────┴───────────────╯                                   ╰───────────────┴───────────────┴───────────────┴───────────────┴───────────────╯ */
                                                                                                     ,
/*                                         ╭───────────────┬───────────────┬───────────────╮                   ╭───────────────┬───────────────┬───────────────╮                                         */
                                            _x_             _x_             _x_                                  _x_             _x_             _x_
/*                                         ├───────────────┼───────────────┼───────────────┤       */,/*       ├───────────────┼───────────────┼───────────────┤                                         */
                                            _x_             _x_             _x_                                 _x_             _x_             _x_
/*                                         ╰───────────────┴───────────────┴───────────────╯                   ╰───────────────┴───────────────┴───────────────╯                                         */
)

// 3
GLV80_LAYER(langlyr,
/* ╭───────────────┬───────────────┬───────────────┬───────────────┬───────────────╮                                   ╭───────────────┬───────────────┬───────────────┬───────────────┬───────────────╮ */
    ___              ___            &magic 1 0      &to 2           &to 0                                               ___             ___             ___             ___             ___
/* ├───────────────┼───────────────┼───────────────┼───────────────┼───────────────┼───────────────╮   ╭───────────────┼───────────────┼───────────────┼───────────────┼───────────────┼───────────────┤ */
    ___             ___             ___             ___             ___             ___                 ___             ___             ___             ___             ___             ___
/* ├───────────────┼───────────────┼───────────────┼───────────────┼───────────────┼───────────────┤   ├───────────────┼───────────────┼───────────────┼───────────────┼───────────────┼───────────────┤ */
    ___             ___             ___             ___             ___             ___                 ___             ___             &de_ue          ___             ___             ___
/* ├───────────────┼───────────────┼───────────────┼───────────────┼───────────────┼───────────────┤   ├───────────────┼───────────────┼───────────────┼───────────────┼───────────────┼───────────────┤ */
    ___             &de_ae          ___             &si_scaron      ___             ___                 ___             ___             &curr_euro      ___             &de_oe           ___
/* ├───────────────┼───────────────┼───────────────┼───────────────┼───────────────┼───────────────┤   ├───────────────┼───────────────┼───────────────┼───────────────┼───────────────┼───────────────┤ */
    ___             &si_zcaron      ___             &si_ccaron      ___             ___              ,  ___             ___             ___             ___             ___             ___
/* ├───────────────┼───────────────┼───────────────┼───────────────┼───────────────┼───────────────╯   ╰───────────────┼───────────────┼───────────────┼───────────────┼───────────────┼───────────────┤ */
    ___             ___             ___             ___             ___                              ,                  ___             ___             ___             ___             ___
/* ╰───────────────┴───────────────┴───────────────┴───────────────┴───────────────╯                                   ╰───────────────┴───────────────┴───────────────┴───────────────┴───────────────╯ */
                                                                                                     ,
/*                                         ╭───────────────┬───────────────┬───────────────╮                   ╭───────────────┬───────────────┬───────────────╮                                         */
                                            ___             ___             ___                                  ___             ___             ___
/*                                         ├───────────────┼───────────────┼───────────────┤       */,/*       ├───────────────┼───────────────┼───────────────┤                                         */
                                            &kp BSPC        &kp LSHFT       &magic 1 0                           _x_             &kp ENTER       &kp SPACE
/*                                         ╰───────────────┴───────────────┴───────────────╯                   ╰───────────────┴───────────────┴───────────────╯                                         */
)

// 4
GLV80_LAYER(nums,
/* ╭───────────────┬───────────────┬───────────────┬───────────────┬───────────────╮                                   ╭───────────────┬───────────────┬───────────────┬───────────────┬───────────────╮ */
    ___             ___             ___             ___             ___                                                 ___             ___             ___             ___             ___
/* ├───────────────┼───────────────┼───────────────┼───────────────┼───────────────┼───────────────╮   ╭───────────────┼───────────────┼───────────────┼───────────────┼───────────────┼───────────────┤ */
    ___             ___             ___             ___             ___             ___                 ___             ___             ___             ___             ___             ___
/* ├───────────────┼───────────────┼───────────────┼───────────────┼───────────────┼───────────────┤   ├───────────────┼───────────────┼───────────────┼───────────────┼───────────────┼───────────────┤ */
    ___             &kp LBKT        &kp LPAR        &kp LBRC        &kp SEMI        &kp LT              &kp BSLH        &kp N7          &kp N8          &kp N9          &kp PLUS        ___
/* ├───────────────┼───────────────┼───────────────┼───────────────┼───────────────┼───────────────┤   ├───────────────┼───────────────┼───────────────┼───────────────┼───────────────┼───────────────┤ */
    ___             &kp RBKT        &kp RPAR        &kp RBRC        &kp COLON       &kp GT              &kp UNDERSCORE  &kp N4          &kp N5          &kp N6          &kp EQUAL       ___
/* ├───────────────┼───────────────┼───────────────┼───────────────┼───────────────┼───────────────┤   ├───────────────┼───────────────┼───────────────┼───────────────┼───────────────┼───────────────┤ */
    ___             &kp PIPE        &kp DQT         &kp SQT         &kp FSLH        &kp LSHFT        ,  &kp QMARK       &kp N1          &kp N2          &kp N3          &kp MINUS       ___
/* ├───────────────┼───────────────┼───────────────┼───────────────┼───────────────┼───────────────╯   ╰───────────────┼───────────────┼───────────────┼───────────────┼───────────────┼───────────────┤ */
    ___             ___             ___             ___             ___                              ,                  ___             ___             ___             ___             ___
/* ╰───────────────┴───────────────┴───────────────┴───────────────┴───────────────╯                                   ╰───────────────┴───────────────┴───────────────┴───────────────┴───────────────╯ */
                                                                                                     ,
/*                                         ╭───────────────┬───────────────┬───────────────╮                   ╭───────────────┬───────────────┬───────────────╮                                         */
                                            ___             ___             ___                                 ___             ___             ___
/*                                         ├───────────────┼───────────────┼───────────────┤       */,/*       ├───────────────┼───────────────┼───────────────┤                                         */
                                            _x_             _x_             _x_                                 ___             &kp DOT         &kp N0
/*                                         ╰───────────────┴───────────────┴───────────────╯                   ╰───────────────┴───────────────┴───────────────╯                                         */
)

// 5
GLV80_LAYER(sym,
/* ╭───────────────┬───────────────┬───────────────┬───────────────┬───────────────╮                                   ╭───────────────┬───────────────┬───────────────┬───────────────┬───────────────╮ */
    ___             ___             ___             ___             ___                                                 ___             ___             ___             ___             ___
/* ├───────────────┼───────────────┼───────────────┼───────────────┼───────────────┼───────────────╮   ╭───────────────┼───────────────┼───────────────┼───────────────┼───────────────┼───────────────┤ */
    ___             ___             ___             ___             ___             ___                 ___             ___             ___             ___             ___             ___
/* ├───────────────┼───────────────┼───────────────┼───────────────┼───────────────┼───────────────┤   ├───────────────┼───────────────┼───────────────┼───────────────┼───────────────┼───────────────┤ */
    ___             &kp PAGE_UP     &kp DEL         &kp UP          &kp TAB         ___                 &kp HOME        &kp F7          &kp F8          &kp F9          &kp F10         ___
/* ├───────────────┼───────────────┼───────────────┼───────────────┼───────────────┼───────────────┤   ├───────────────┼───────────────┼───────────────┼───────────────┼───────────────┼───────────────┤ */
    ___             &kp PAGE_DOWN   &kp LEFT        &kp DOWN        &kp RIGHT       ___                 &kp END         &kp F4          &kp F5          &kp F6          &kp F11         ___
/* ├───────────────┼───────────────┼───────────────┼───────────────┼───────────────┼───────────────┤   ├───────────────┼───────────────┼───────────────┼───────────────┼───────────────┼───────────────┤ */
    ___             &kp PRINTSCREEN &kp CAPS        &kp LALT        &kp LGUI        ___              ,  &kp TILDE       &kp F1          &kp F2          &kp F3          &kp F12         ___
/* ├───────────────┼───────────────┼───────────────┼───────────────┼───────────────┼───────────────╯   ╰───────────────┼───────────────┼───────────────┼───────────────┼───────────────┼───────────────┤ */
    ___             ___             ___             ___             ___                              ,                  ___             ___             ___             ___             ___
/* ╰───────────────┴───────────────┴───────────────┴───────────────┴───────────────╯                                   ╰───────────────┴───────────────┴───────────────┴───────────────┴───────────────╯ */
                                                                                                     ,
/*                                         ╭───────────────┬───────────────┬───────────────╮                   ╭───────────────┬───────────────┬───────────────╮                                         */
                                            ___             ___             ___                                 ___             ___             ___
/*                                         ├───────────────┼───────────────┼───────────────┤      */ , /*      ├───────────────┼───────────────┼───────────────┤                                         */
                                            _x_             _x_             _x_                                 &go_assign      &kp GRAVE       &kp TILDE
/*                                         ╰───────────────┴───────────────┴───────────────╯                   ╰───────────────┴───────────────┴───────────────╯                                         */
)
